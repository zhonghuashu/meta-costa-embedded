## conf/distro/costa-embedded.conf
```bitbake
require conf/distro/poky.conf

DISTRO = "costa-embedded"
DISTRO_NAME = "costa-embedded (Costa Embedded Linux by Yocto)"
DISTRO_VERSION = "4.0.18"
DISTRO_CODENAME = "kirkstone"
SDK_VENDOR = "-costaembeddedsdk"
SDK_VERSION = "${@d.getVar('DISTRO_VERSION').replace('snapshot-${METADATA_REVISION}', 'snapshot')}"
SDK_VERSION[vardepvalue] = "${SDK_VERSION}"

MAINTAINER = "Costa Embedded <zhonghua.shu@qq.com>"

TARGET_VENDOR = "-costaembedded"
```

## conf/layer.conf
```bitbake
# We have a conf and classes directory, add to BBPATH
BBPATH .= ":${LAYERDIR}"

# We have recipes-* directories, add to BBFILES
BBFILES += "${LAYERDIR}/recipes-*/*/*.bb \
            ${LAYERDIR}/recipes-*/*/*.bbappend"

BBFILE_COLLECTIONS += "costa-embedded"
BBFILE_PATTERN_costa-embedded = "^${LAYERDIR}/"
BBFILE_PRIORITY_costa-embedded = "20"

LAYERDEPENDS_costa-embedded = "core"
LAYERSERIES_COMPAT_costa-embedded = "kirkstone"
```
